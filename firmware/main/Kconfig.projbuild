## firmware/main/Kconfig.projbuild
```kconfig
menu "CO2 Sensor Wi-Fi"

    config WIFI_SSID
        string "wifi name"

    config WIFI_PASSWORD
        string "password"

endmenu

menu "Supabase"

    config SUPABASE_UPLOAD
        bool "Upload readings to Supabase"
        default n
        help
            When off, Wi-Fi is not started and readings are only printed to the serial log.

    config SUPABASE_URL
        string "Project URL"
        default "https://ddztprtbewutziquuqqu.supabase.co/rest/v1/"
        help
            Supabase dashboard -> Project Settings -> API -> Project URL.
            No trailing slash.

    config SUPABASE_ANON_KEY
        string "Anon (publishable) API key"
        default "sb_publishable_gdTOXI5XScfBns9iV0pC3A_RgsS2V-n"
        help
            Supabase dashboard -> Project Settings -> API Keys -> anon / publishable key.
            Never use the service_role (secret) key on the device.

    config READING_INTERVAL_SEC
        int "Seconds between readings"
        default 5
        range 5 86400

endmenu
```

## main/Kconfig.projbuild
```kconfig
menu "CO2 Sensor Wi-Fi"

    config WIFI_SSID
        string "wifi name"

    config WIFI_PASSWORD
        string "password"

endmenu
```
